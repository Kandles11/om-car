VERSION ""

NS_ :

BS_:

BU_:

BO_ 256 Accelerator_Pedal_Message: 1 Vector__XXX
 SG_ Accelerator_Pedal_Position : 0|8@1+ (1,0) [-100|100] "%" Vector__XXX

CM_ SG_ 256 Accelerator_Pedal_Position "The position of the accelerator pedal";
